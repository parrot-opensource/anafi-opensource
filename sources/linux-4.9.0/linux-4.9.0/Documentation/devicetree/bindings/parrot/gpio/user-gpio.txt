## sources/perf-unknown/perf-unknown/drivers/ambalink/Kconfig
```kconfig
menuconfig ARCH_AMBARELLA_AMBALINK
	bool "AmbaLink Support"
        depends on ARCH_AMBARELLA
        select AMBALINK_LOCK
        select RPMSG_VIRTIO
	help
                This enables AmbaLink support for Ambarella ARMv8 SoC Family.

if ARCH_AMBARELLA_AMBALINK

source "drivers/ambalink/service/Kconfig"
source "drivers/ambalink/rpc/Kconfig"

endif
```

## sources/perf-unknown/perf-unknown/drivers/net/ethernet/ambarella/Kconfig
```kconfig
#
# AMBARELLA network device configuration
#

config NET_VENDOR_AMBARELLA
	tristate "Ambarella 10/100/1000 GMAC Ethernet support"
	depends on ARCH_AMBARELLA
	select CRC32
	select PHYLIB
	select MII
	help
	  This driver supports Ambarella 10/100/1000 GMAC Ethernet.

config NET_VENDOR_AMBARELLA_INTEN_TUE
	bool "Enable Transmit Buffer Unavailable Interrupt"
	depends on NET_VENDOR_AMBARELLA
	default n
	help
	  Enable ETH_DMA_INTEN_TUE will downgrade the performance in most case,
	  but you will get a quick response especially in GMII mode.

	  If you are not sure, say N here.

config NET_VENDOR_AMBARELLA_JUMBO_FRAME
	bool "Enable Jumbo Frame for Amabrella Platform"
	depends on NET_VENDOR_AMBARELLA
	default n
	help
	  Enable Jumbo Frame for Ambarella Platform, this can promote the perforence
	  for Gigabit Ethernet.

	  If you are not sure, say N here.
```

## sources/perf-unknown/perf-unknown/drivers/parrot/gpio/Kconfig
```kconfig
# GPIO infrastructure and drivers
#

config USER_GPIO_EXPORT
	tristate "Parrot user gpio export driver"
	depends on OF
	depends on GPIOLIB
	depends on GPIO_SYSFS
	help
	  Allows to export user gpio from device tree and
	  to create a symlink to the gpio.
```

## sources/perf-unknown/perf-unknown/drivers/parrot/misc/Kconfig
```kconfig
menu "Misc Parrot drivers"

config MISC_PBT
	bool "Pbt"
	depends on ARCH_AMBARELLA_AMBALINK
	help
	  Watch if ThreadX crashed and dump backtrace

config MISC_PBT_PING_INTERVAL_MS
	int "Pbt ping interval (ms)"
	default 1000
	depends on MISC_PBT
	help
	  Delay (msec) between each ThreadX ping request

config MISC_PBT_PING_TIMEOUT_MS
	int "Pbt ping timeout (ms)"
	default 5000
	depends on MISC_PBT
	help
	  ThreadX is considered to be crashed after this timeout, and backtrace
	  will be available by reading the char device.

config MISC_PGIMBAL
	#THREADX-DEPENDS: CONFIG_PARROT_GIMBAL=y
	tristate "Parrot Gimbal"
	help
	  This driver allows to share low frequency gimbal data with ThreadX.

config MISC_PSFS
	#THREADX-DEPENDS: CONFIG_PARROT_PSFS=y
	tristate "Parrot Shared Filesystem"
	help
	  This driver allows to share local filesystems with a remote oprating
	  system.

config MISC_PSHM
	tristate "Pshm"
	help
	  Shared memory management between ThreadX and Linux

config MISC_PTEST_CLOCK
	tristate "Ptest clock"
	help
	  Linux part to verify linux/threadx clock synchronisation

config MISC_PTEST_OOPS
	tristate "Ptest oops"
	help
	  Linux part to verify oops dump

endmenu
```

## sources/perf-unknown/perf-unknown/drivers/parrot/stepper/Kconfig
```kconfig
config AMBA_STEPPER_US
	tristate "Ambarella Stepper driver for US"
	help
	  This driver is dedicated to sending a fixed number of pulses on US Tx
```

## sources/perf-unknown/perf-unknown/drivers/parrot/wifi/Kconfig
```kconfig
config ENABLE_WIRELESS_EXT
	   bool "Wireless extensions"
	   default n
	   select WEXT_CORE
	   select WEXT_PROC
	   select WEXT_SPY
	   select WEXT_PRIV
	   select WIRELESS_EXT
```

## sources/perf-unknown/perf-unknown/drivers/rpmsg/ambarella/Kconfig
```kconfig
menu "Ambarella RPMSG Host Programs"
depends on AMBARELLA_RPROC

source "drivers/rpmsg/ambarella/host/echo/Kconfig"

endmenu

menu "Ambarella RPMSG Client Programs"
depends on RPCLNT_SUPPORT

source "drivers/rpmsg/ambarella/clnt/echo/Kconfig"

endmenu
```

## sources/perf-unknown/perf-unknown/drivers/soc/ambarella/Kconfig
```kconfig
#
# Ambarella SoC drivers
#

config AMBARELLA_SUPPORT_GDMA
	bool "Ambarella Enable GDMA"
        depends on ARCH_AMBARELLA
	default n
	help
	  Say y here to enable gdma
```
