## sources/linux-4.9.0/linux-4.9.0/Documentation/devicetree/bindings/parrot/gpio/user-gpio.txt
```
USER-GPIO exports GPIO to sysfs with a symlink

required properties:
- compatible: Should be "parrot,user-gpio"

Each child node will represent a GPIO. The child node name is used
to set the symlink name.

required properties:
- gpios: GPIO to export

optional properties:
 - output = <val>: to set it as output with default value
	   if not present gpio as input
 - debounce = <val>: debounce time is microseconds
 - interrupt-edge-{both,rising,falling}: to enable specified interrupt
	   type for gpio
 - active-low: if gpio should be considered as active low

Example:
	user-gpio {
		compatible = "parrot,user-gpio";

		gnss_flash_n {
			output = <0>;
			gpios = <&gpio TEGRA_GPIO(H, 6) 0>;
		};

		gnss_rst_n {
			output = <0>;
			gpios = <&gpio TEGRA_GPIO(EE, 2) 0>;
		};

		wifi_rst_n {
			output = <1>;
			gpios = <&tca9539_74 9 0>;
		};

		wifi_en {
			output = <1>;
			gpios = <&tca9539_74 10 0>;
		};

		pwr_btn {
			gpios = <&tca9539_74 11 0>;
			active-low;
			interrupt-edge-both;
		}
	};
```

## sources/linux-4.9.0/linux-4.9.0/arch/arm/mach-ambarella/Kconfig
```kconfig
#
# arch/arm/mach-ambarella/Kconfig
#
# History:
#	2006/12/18 - [Charles Chiou] created file
#
# Copyright (C) 2004-2009, Ambarella, Inc.
#
# This program is free software; you can redistribute it and/or modify
# it under the terms of the GNU General Public License as published by
# the Free Software Foundation; either version 2 of the License, or
# (at your option) any later version.
#
# This program is distributed in the hope that it will be useful,
# but WITHOUT ANY WARRANTY; without even the implied warranty of
# MERCHANTABILITY or FITNESS FOR A PARTICULAR PURPOSE.  See the
# GNU General Public License for more details.
#
# You should have received a copy of the GNU General Public License
# along with this program; if not, write to the Free Software
# Foundation, Inc., 59 Temple Place, Suite 330, Boston, MA 02111-1307 USA
#

if ARCH_AMBARELLA
comment "Ambarella Platform"

config ARCH_AMBARELLA_SUPPORT_MMAP_AXI
	bool
	default n

config ARCH_AMBARELLA_SUPPORT_MMAP_DRAMC
	bool
	default n

config ARCH_AMBARELLA_SUPPORT_MMAP_DBGBUS
	bool
	default n

choice
	prompt "Chip REV"

config ARCH_AMBARELLA_S2E
	bool "S2E"
	select CPU_V7
	select HAVE_SMP
	select HAVE_ARM_SCU if SMP
	select ARM_ERRATA_754322
	select ARM_ERRATA_764369 if SMP
	select ARM_ERRATA_775420
	select MIGHT_HAVE_CACHE_L2X0
	select PL310_ERRATA_588369 if CACHE_PL310
	select PL310_ERRATA_727915 if CACHE_PL310
	select USB_ARCH_HAS_EHCI if USB_SUPPORT
	select USB_ARCH_HAS_OHCI if USB_SUPPORT
	select ARCH_AMBARELLA_SUPPORT_MMAP_AXI
	select ARCH_AMBARELLA_SUPPORT_MMAP_DRAMC
	select AMBARELLA_VIC
	help
	  Say Y here if you are using Ambarella S2E.

config ARCH_AMBARELLA_S2L
	bool "S2L"
	select CPU_V7
	select MIGHT_HAVE_CACHE_L2X0
	select PL310_ERRATA_588369 if CACHE_PL310
	select PL310_ERRATA_727915 if CACHE_PL310
	select USB_ARCH_HAS_EHCI if USB_SUPPORT
	select USB_ARCH_HAS_OHCI if USB_SUPPORT
	select ARCH_AMBARELLA_SUPPORT_MMAP_AXI
	select ARCH_AMBARELLA_SUPPORT_MMAP_DRAMC
	select ARCH_AMBARELLA_SUPPORT_MMAP_DBGBUS
	select AMBARELLA_VIC
	help
	  Say Y here if you are using Ambarella S2L.

config ARCH_AMBARELLA_S3
	bool "S3"
	select CPU_V7
	select HAVE_SMP
	select HAVE_ARM_SCU if SMP
	select ARM_ERRATA_764369 if SMP
	select MIGHT_HAVE_CACHE_L2X0
	select PL310_ERRATA_588369 if CACHE_PL310
	select PL310_ERRATA_727915 if CACHE_PL310
	select USB_ARCH_HAS_EHCI if USB_SUPPORT
	select USB_ARCH_HAS_OHCI if USB_SUPPORT
	select ARCH_AMBARELLA_SUPPORT_MMAP_AXI
	select ARCH_AMBARELLA_SUPPORT_MMAP_DRAMC
	select ARCH_AMBARELLA_SUPPORT_MMAP_DBGBUS
	select AMBARELLA_VIC
	select NET_VENDOR_AMBARELLA_ENHANCED if NET_VENDOR_AMBARELLA
	help
	  Say Y here if you are using Ambarella S3.

config ARCH_AMBARELLA_S3L
	bool "S3L"
	select CPU_V7
	select MIGHT_HAVE_CACHE_L2X0
	select PL310_ERRATA_588369 if CACHE_PL310
	select PL310_ERRATA_727915 if CACHE_PL310
	select USB_ARCH_HAS_EHCI if USB_SUPPORT
	select USB_ARCH_HAS_OHCI if USB_SUPPORT
	select ARCH_AMBARELLA_SUPPORT_MMAP_AXI
	select ARCH_AMBARELLA_SUPPORT_MMAP_DRAMC
	select ARCH_AMBARELLA_SUPPORT_MMAP_DBGBUS
	select AMBARELLA_VIC
	help
	  Say Y here if you are using Ambarella S3L.

endchoice

menu "Generic Platform Configuration"
config AMBARELLA_RAW_BOOT
	bool "Raw boot mode"
	default n
	help
	  If you are not sure, say N here.

config AMBARELLA_PMUSERENR_EN
	bool "Enable userspcae access to PMU"
	default n
	help
	  Enable userspcae access to PMU

menu "Proc file system support"
depends on PROC_FS

config AMBARELLA_PLL_PROC
	bool "Suport Ambarella PLL proc"
	default n
	---help---
	  /proc/ambarella/clock

	  If you are not sure, say N here.

config AMBARELLA_SUPPORT_AMBENCH
	bool "Suport Ambarella Test (ambench)"
	default n
	help
	  /proc/ambarella/ambench

	  If you are not sure, say N here.

endmenu

menu "Memory Configuration"

config AMBARELLA_PPM_SIZE
	hex "PPM SIZE"
	default 0x00000000
	range 0x00000000 0x10000000 if VMSPLIT_3G
	range 0x00000000 0x20000000 if VMSPLIT_2G
	range 0x00000000 0x60000000 if VMSPLIT_1G
	help
	  Specify the size from the start of physical DRAM address to reserve.

config AMBARELLA_MEMORY_SIZE
	hex "Default MEMORY SIZE"
	depends on AMBARELLA_RAW_BOOT
	default 0x08000000
	range 0x04000000 0x40000000
	help
	  Specify the size of physical DRAM for debug.

config AMBARELLA_ZRELADDR
	hex "ZRELADDR"
	default 0x00108000
	help
	  Specify the kernel entry point start physical address.

config AMBARELLA_TEXTOFS
	hex "TEXTOFS"
	default 0x00108000
	help
	  Speicify the relative text offset.

config AMBARELLA_PARAMS_PHYS
	hex "PARAMS PHYS"
	default 0x000c0000
	help
	  Specify the physical address for kernel parameters.

config AMBARELLA_INITRD_PHYS
	hex "INITRD PHYS"
	default 0x00a00000
	help
	  Specify the physical address for initrd.

config AMBARELLA_PPM_UNCACHED
	bool "Map PPM as MT_DEVICE"
	default n
	help
	  Default MT_MEMORY.

endmenu

config AMBARELLA_TIMER_HIGHRES
	bool "High resolution timer wrapper Support"
	default n
	depends on HIGH_RES_TIMERS
	help
		Add high resolution timer wrapper for non-GPL

config AMBARELLA_EXT_IRQ_NUM
	int "External IRQ Num"
	range 0 256
	default 64
	help
	  Depends on your HW design.

config AMBARELLA_EXT_GPIO_NUM
	int "External GPIO Num"
	range 0 256
	default 64
	help
	  Depends on your HW design.

config AMBARELLA_SREF_FIFO_EXEC
	bool "Self refresh code executed in FIO fifo"
	default n
	depends on PLAT_AMBARELLA_SUPPORT_PM
	help
		Self refresh 2nd solution.

endmenu

endif
```

## sources/linux-4.9.0/linux-4.9.0/arch/arm64/configs/ambarella_h22_ambalink_bt_lte_defconfig
```kconfig
# CONFIG_LOCALVERSION_AUTO is not set
CONFIG_DEFAULT_HOSTNAME="Ambarella"
CONFIG_SYSVIPC=y
CONFIG_POSIX_MQUEUE=y
CONFIG_USELIB=y
CONFIG_IRQ_DOMAIN_DEBUG=y
CONFIG_NO_HZ_IDLE=y
CONFIG_HIGH_RES_TIMERS=y
CONFIG_BSD_PROCESS_ACCT=y
CONFIG_BSD_PROCESS_ACCT_V3=y
CONFIG_IKCONFIG=y
CONFIG_IKCONFIG_PROC=y
CONFIG_LOG_BUF_SHIFT=16
CONFIG_CGROUP_HUGETLB=y
CONFIG_NAMESPACES=y
# CONFIG_UTS_NS is not set
# CONFIG_IPC_NS is not set
CONFIG_SCHED_AUTOGROUP=y
CONFIG_EXPERT=y
# CONFIG_PERF_EVENTS is not set
# CONFIG_COMPAT_BRK is not set
CONFIG_PROFILING=y
CONFIG_JUMP_LABEL=y
CONFIG_MODULES=y
CONFIG_MODULE_UNLOAD=y
CONFIG_BLK_DEV_BSGLIB=y
CONFIG_PARTITION_ADVANCED=y
# CONFIG_EFI_PARTITION is not set
CONFIG_ARCH_AMBARELLA=y
CONFIG_ARCH_AMBARELLA_S5L=y
CONFIG_NR_CPUS=4
CONFIG_PREEMPT=y
# CONFIG_BOUNCE is not set
CONFIG_CMA=y
# CONFIG_EFI is not set
# CONFIG_CORE_DUMP_DEFAULT_ELF_HEADERS is not set
CONFIG_COMPAT=y
CONFIG_HIBERNATION=y
CONFIG_NET=y
CONFIG_PACKET=y
CONFIG_UNIX=y
CONFIG_UNIX_DIAG=y
CONFIG_XFRM_USER=y
CONFIG_INET=y
CONFIG_IP_MULTICAST=y
CONFIG_IP_ADVANCED_ROUTER=y
CONFIG_IP_PNP=y
CONFIG_IP_PNP_DHCP=y
CONFIG_IP_PNP_BOOTP=y
# CONFIG_INET_XFRM_MODE_TRANSPORT is not set
# CONFIG_INET_XFRM_MODE_TUNNEL is not set
# CONFIG_INET_XFRM_MODE_BEET is not set
# CONFIG_INET_DIAG is not set
# CONFIG_IPV6 is not set
CONFIG_NETFILTER=y
CONFIG_NF_CONNTRACK=y
# CONFIG_NF_CONNTRACK_PROCFS is not set
CONFIG_NF_CONNTRACK_IPV4=y
CONFIG_IP_NF_IPTABLES=y
CONFIG_IP_NF_FILTER=y
CONFIG_IP_NF_NAT=y
CONFIG_IP_NF_TARGET_MASQUERADE=y
CONFIG_DNS_RESOLVER=y
CONFIG_BT=y
CONFIG_BT_RFCOMM=y
CONFIG_BT_RFCOMM_TTY=y
CONFIG_BT_HIDP=y
# CONFIG_BT_HS is not set
CONFIG_BT_HCIBTUSB=m
# CONFIG_BT_HCIBTUSB_BCM is not set
CONFIG_BT_HCIUART=y
CONFIG_BT_HCIUART_H4=y
CONFIG_BT_BLUESLEEP=y
CONFIG_BT_BLUESLEEP_DEV_WAKEUP=22
CONFIG_BT_HCIUART_3WIRE=y
CONFIG_CFG80211=m
CONFIG_CFG80211_DEBUGFS=y
CONFIG_CFG80211_INTERNAL_REGDB=y
CONFIG_CFG80211_WEXT=y
CONFIG_MAC80211=m
CONFIG_RFKILL=y
CONFIG_ARCH_AMBARELLA_AMBALINK=y
CONFIG_DEVTMPFS=y
CONFIG_DEVTMPFS_MOUNT=y
# CONFIG_STANDALONE is not set
# CONFIG_PREVENT_FIRMWARE_BUILD is not set
# CONFIG_FIRMWARE_IN_KERNEL is not set
CONFIG_DMA_CMA=y
CONFIG_CONNECTOR=y
CONFIG_MTD=y
CONFIG_MTD_CMDLINE_PARTS=y
CONFIG_MTD_BLOCK_AMBRO=y
CONFIG_MTD_NAND=y
CONFIG_MTD_NAND_ECC_BCH=y
CONFIG_MTD_NAND_AMBARELLA=y
CONFIG_MTD_UBI=y
CONFIG_BLK_DEV_LOOP=y
CONFIG_BLK_DEV_RAM=y
CONFIG_BLK_DEV_RAM_COUNT=1
CONFIG_BLK_DEV_RAM_SIZE=65536
CONFIG_SCSI=m
CONFIG_BLK_DEV_SD=m
CONFIG_NETDEVICES=y
CONFIG_NET_VENDOR_AMBARELLA=m
CONFIG_NET_VENDOR_AMBARELLA_INTEN_TUE=y
# CONFIG_NET_VENDOR_AMD is not set
# CONFIG_NET_VENDOR_ARC is not set
# CONFIG_NET_CADENCE is not set
# CONFIG_NET_VENDOR_BROADCOM is not set
# CONFIG_NET_VENDOR_EZCHIP is not set
# CONFIG_NET_VENDOR_HISILICON is not set
# CONFIG_NET_VENDOR_INTEL is not set
# CONFIG_NET_VENDOR_MARVELL is not set
# CONFIG_NET_VENDOR_MICREL is not set
# CONFIG_NET_VENDOR_NATSEMI is not set
# CONFIG_NET_VENDOR_QUALCOMM is not set
# CONFIG_NET_VENDOR_RENESAS is not set
# CONFIG_NET_VENDOR_ROCKER is not set
# CONFIG_NET_VENDOR_SAMSUNG is not set
# CONFIG_NET_VENDOR_SEEQ is not set
# CONFIG_NET_VENDOR_SMSC is not set
# CONFIG_NET_VENDOR_STMICRO is not set
# CONFIG_NET_VENDOR_SYNOPSYS is not set
# CONFIG_NET_VENDOR_VIA is not set
# CONFIG_NET_VENDOR_WIZNET is not set
CONFIG_MICREL_PHY=m
CONFIG_REALTEK_PHY=m
CONFIG_PPP=y
CONFIG_PPP_ASYNC=y
CONFIG_USB_USBNET=m
# CONFIG_USB_NET_AX8817X is not set
# CONFIG_USB_NET_AX88179_178A is not set
# CONFIG_USB_NET_NET1080 is not set
CONFIG_USB_NET_RNDIS_HOST=m
# CONFIG_USB_BELKIN is not set
# CONFIG_USB_ARMLINUX is not set
# CONFIG_USB_NET_ZAURUS is not set
CONFIG_USB_NET_QMI_WWAN=m
# CONFIG_WLAN is not set
# CONFIG_INPUT_MOUSEDEV is not set
CONFIG_INPUT_EVDEV=m
# CONFIG_KEYBOARD_ATKBD is not set
# CONFIG_INPUT_MOUSE is not set
CONFIG_INPUT_MISC=y
CONFIG_INPUT_UINPUT=m
# CONFIG_SERIO is not set
CONFIG_VT_HW_CONSOLE_BINDING=y
# CONFIG_LEGACY_PTYS is not set
# CONFIG_DEVKMEM is not set
CONFIG_SERIAL_AMBARELLA=y
CONFIG_SERIAL_AMBARELLA_CONSOLE=y
# CONFIG_HW_RANDOM is not set
CONFIG_GPIOLIB=y
CONFIG_GPIO_SYSFS=y
# CONFIG_HWMON is not set
CONFIG_MFD_SYSCON=y
CONFIG_HIDRAW=y
CONFIG_HID_A4TECH=y
CONFIG_HID_APPLE=y
CONFIG_HID_BELKIN=y
CONFIG_HID_CHERRY=y
CONFIG_HID_CHICONY=y
CONFIG_HID_CYPRESS=y
CONFIG_HID_EZKEY=y
CONFIG_HID_KENSINGTON=y
CONFIG_HID_LOGITECH=y
CONFIG_HID_MICROSOFT=y
CONFIG_HID_MONTEREY=y
CONFIG_USB=m
CONFIG_USB_ANNOUNCE_NEW_DEVICES=y
# CONFIG_USB_DEFAULT_PERSIST is not set
CONFIG_USB_EHCI_HCD=m
CONFIG_USB_EHCI_ROOT_HUB_TT=y
CONFIG_USB_EHCI_AMBARELLA=m
CONFIG_USB_OHCI_HCD=m
CONFIG_USB_OHCI_AMBARELLA=y
CONFIG_USB_ACM=m
CONFIG_USB_STORAGE=m
CONFIG_USB_SERIAL=m
CONFIG_USB_SERIAL_GENERIC=y
CONFIG_USB_SERIAL_QUALCOMM=m
CONFIG_USB_SERIAL_OPTION=m
CONFIG_USB_AMBARELLA_PHY=y
CONFIG_USB_GADGET=y
CONFIG_USB_GADGET_VBUS_DRAW=500
CONFIG_USB_AMBARELLA=m
CONFIG_USB_ETH=m
CONFIG_USB_MASS_STORAGE=m
CONFIG_USB_G_SERIAL=m
CONFIG_USB_G_MULTI=m
CONFIG_MMC=y
CONFIG_PWRSEQ_EMMC=m
CONFIG_PWRSEQ_SIMPLE=m
CONFIG_MMC_BLOCK=m
CONFIG_MMC_BLOCK_MINORS=32
# CONFIG_MMC_BLOCK_BOUNCE is not set
CONFIG_MMC_AMBARELLA=y
CONFIG_RTC_CLASS=y
CONFIG_RTC_INTF_DEV_UIE_EMUL=y
CONFIG_RTC_DRV_AMBARELLA=y
# CONFIG_COMMON_CLK_XGENE is not set
# CONFIG_IOMMU_SUPPORT is not set
CONFIG_AMBARELLA_RPROC=y
CONFIG_RPMSG_ECHO=y
CONFIG_EXT4_FS=m
CONFIG_EXT4_FS_POSIX_ACL=y
CONFIG_EXT4_FS_SECURITY=y
# CONFIG_DNOTIFY is not set
CONFIG_FUSE_FS=m
CONFIG_CUSE=m
CONFIG_VFAT_FS=y
CONFIG_TMPFS=y
CONFIG_TMPFS_POSIX_ACL=y
CONFIG_HUGETLBFS=y
CONFIG_CONFIGFS_FS=y
CONFIG_UBIFS_FS=y
CONFIG_UBIFS_FS_ADVANCED_COMPR=y
CONFIG_SQUASHFS=y
CONFIG_SQUASHFS_LZ4=y
CONFIG_SQUASHFS_LZO=y
CONFIG_SQUASHFS_XZ=y
CONFIG_NFS_FS=y
CONFIG_NLS_DEFAULT="utf8"
CONFIG_NLS_CODEPAGE_437=y
CONFIG_NLS_ISO8859_1=y
CONFIG_NLS_UTF8=y
CONFIG_PRINTK_TIME=y
CONFIG_DYNAMIC_DEBUG=y
CONFIG_DEBUG_INFO=y
CONFIG_DEBUG_FS=y
CONFIG_DEBUG_SECTION_MISMATCH=y
# CONFIG_FTRACE is not set
# CONFIG_DEBUG_SET_MODULE_RONX is not set
CONFIG_KEYS=y
CONFIG_CRYPTO_HMAC=y
CONFIG_CRYPTO_CRC32C=y
CONFIG_CRYPTO_MD4=y
CONFIG_CRYPTO_MD5=y
CONFIG_CRYPTO_ARC4=y
CONFIG_CRYPTO_DES=y
CONFIG_CRYPTO_ANSI_CPRNG=y
CONFIG_ARM64_CRYPTO=y
CONFIG_CRYPTO_SHA1_ARM64_CE=y
CONFIG_CRYPTO_SHA2_ARM64_CE=y
CONFIG_CRYPTO_GHASH_ARM64_CE=y
CONFIG_CRYPTO_AES_ARM64_CE_CCM=y
CONFIG_CRYPTO_AES_ARM64_CE_BLK=y
CONFIG_CRYPTO_AES_ARM64_NEON_BLK=y
CONFIG_CRC_ITU_T=y
CONFIG_CRC7=y
```
