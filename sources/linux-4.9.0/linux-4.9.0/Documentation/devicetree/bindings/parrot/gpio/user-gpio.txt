## sources/linux-4.9.0/linux-4.9.0/arch/arm64/configs/ambarella_h22_ambalink_emmc_defconfig
```kconfig
# CONFIG_LOCALVERSION_AUTO is not set
CONFIG_DEFAULT_HOSTNAME="Ambarella"
CONFIG_SYSVIPC=y
CONFIG_POSIX_MQUEUE=y
CONFIG_IRQ_DOMAIN_DEBUG=y
CONFIG_NO_HZ_IDLE=y
CONFIG_HIGH_RES_TIMERS=y
CONFIG_BSD_PROCESS_ACCT=y
CONFIG_BSD_PROCESS_ACCT_V3=y
CONFIG_IKCONFIG=y
CONFIG_IKCONFIG_PROC=y
CONFIG_LOG_BUF_SHIFT=16
CONFIG_CGROUPS=y
CONFIG_CGROUP_SCHED=y
# CONFIG_UTS_NS is not set
# CONFIG_IPC_NS is not set
# CONFIG_NET_NS is not set
CONFIG_BLK_DEV_INITRD=y
CONFIG_KALLSYMS_ALL=y
# CONFIG_PERF_EVENTS is not set
# CONFIG_COMPAT_BRK is not set
CONFIG_PROFILING=y
CONFIG_JUMP_LABEL=y
CONFIG_MODULES=y
CONFIG_MODULE_UNLOAD=y
CONFIG_BLK_DEV_BSGLIB=y
CONFIG_PARTITION_ADVANCED=y
# CONFIG_MSDOS_PARTITION is not set
# CONFIG_EFI_PARTITION is not set
CONFIG_ARCH_AMBARELLA=y
CONFIG_ARCH_AMBARELLA_S5L=y
CONFIG_NR_CPUS=4
CONFIG_PREEMPT=y
# CONFIG_BOUNCE is not set
CONFIG_CMA=y
CONFIG_CMDLINE="console=ttyS0"
# CONFIG_EFI is not set
# CONFIG_CORE_DUMP_DEFAULT_ELF_HEADERS is not set
CONFIG_COMPAT=y
CONFIG_HIBERNATION=y
CONFIG_NET=y
CONFIG_PACKET=y
CONFIG_UNIX=y
CONFIG_UNIX_DIAG=y
CONFIG_XFRM_USER=y
CONFIG_INET=y
CONFIG_IP_MULTICAST=y
CONFIG_IP_ADVANCED_ROUTER=y
CONFIG_IP_PNP=y
CONFIG_IP_PNP_DHCP=y
CONFIG_IP_PNP_BOOTP=y
# CONFIG_INET_XFRM_MODE_TRANSPORT is not set
# CONFIG_INET_XFRM_MODE_TUNNEL is not set
# CONFIG_INET_XFRM_MODE_BEET is not set
# CONFIG_INET_DIAG is not set
# CONFIG_IPV6 is not set
CONFIG_DNS_RESOLVER=y
CONFIG_BT=m
CONFIG_BT_RFCOMM=m
CONFIG_BT_RFCOMM_TTY=y
CONFIG_BT_BNEP=m
CONFIG_BT_BNEP_MC_FILTER=y
CONFIG_BT_BNEP_PROTO_FILTER=y
CONFIG_BT_HCIUART=m
CONFIG_BT_HCIUART_H4=y
CONFIG_BT_HCIUART_BCSP=y
CONFIG_CFG80211=m
CONFIG_CFG80211_DEBUGFS=y
CONFIG_CFG80211_WEXT=y
CONFIG_MAC80211=m
CONFIG_RFKILL=m
CONFIG_ARCH_AMBARELLA_AMBALINK=y
CONFIG_AMBALINK_SD=y
CONFIG_DEVTMPFS=y
CONFIG_DEVTMPFS_MOUNT=y
# CONFIG_STANDALONE is not set
# CONFIG_PREVENT_FIRMWARE_BUILD is not set
# CONFIG_FIRMWARE_IN_KERNEL is not set
CONFIG_DMA_CMA=y
CONFIG_CONNECTOR=y
CONFIG_BLK_DEV_LOOP=y
CONFIG_BLK_DEV_RAM=y
CONFIG_BLK_DEV_RAM_COUNT=1
CONFIG_BLK_DEV_RAM_SIZE=65536
CONFIG_SCSI=m
CONFIG_BLK_DEV_SD=m
CONFIG_NETDEVICES=y
CONFIG_NETCONSOLE=y
CONFIG_NETCONSOLE_DYNAMIC=y
CONFIG_NET_VENDOR_AMBARELLA=y
CONFIG_NET_VENDOR_AMBARELLA_INTEN_TUE=y
# CONFIG_NET_VENDOR_AMD is not set
# CONFIG_NET_VENDOR_ARC is not set
# CONFIG_NET_CADENCE is not set
# CONFIG_NET_VENDOR_BROADCOM is not set
# CONFIG_NET_VENDOR_EZCHIP is not set
# CONFIG_NET_VENDOR_HISILICON is not set
# CONFIG_NET_VENDOR_INTEL is not set
# CONFIG_NET_VENDOR_MARVELL is not set
# CONFIG_NET_VENDOR_MICREL is not set
# CONFIG_NET_VENDOR_NATSEMI is not set
# CONFIG_NET_VENDOR_QUALCOMM is not set
# CONFIG_NET_VENDOR_RENESAS is not set
# CONFIG_NET_VENDOR_ROCKER is not set
# CONFIG_NET_VENDOR_SAMSUNG is not set
# CONFIG_NET_VENDOR_SEEQ is not set
# CONFIG_NET_VENDOR_SMSC is not set
# CONFIG_NET_VENDOR_STMICRO is not set
# CONFIG_NET_VENDOR_SYNOPSYS is not set
# CONFIG_NET_VENDOR_VIA is not set
# CONFIG_NET_VENDOR_WIZNET is not set
CONFIG_REALTEK_PHY=y
# CONFIG_INPUT_MOUSEDEV is not set
CONFIG_INPUT_EVDEV=m
# CONFIG_INPUT_KEYBOARD is not set
# CONFIG_INPUT_MOUSE is not set
# CONFIG_SERIO is not set
# CONFIG_LEGACY_PTYS is not set
# CONFIG_DEVKMEM is not set
CONFIG_SERIAL_AMBARELLA=y
CONFIG_SERIAL_AMBARELLA_CONSOLE=y
# CONFIG_HW_RANDOM is not set
CONFIG_GPIOLIB=y
CONFIG_GPIO_SYSFS=y
CONFIG_POWER_RESET_XGENE=y
CONFIG_POWER_RESET_SYSCON=y
# CONFIG_HWMON is not set
CONFIG_FB=y
CONFIG_FRAMEBUFFER_CONSOLE=m
CONFIG_HID=m
CONFIG_USB=m
CONFIG_USB_EHCI_HCD=m
CONFIG_USB_EHCI_ROOT_HUB_TT=y
CONFIG_USB_OHCI_HCD=m
CONFIG_USB_OHCI_AMBARELLA=y
CONFIG_USB_STORAGE=m
CONFIG_USB_SERIAL=m
CONFIG_USB_SERIAL_GENERIC=y
CONFIG_USB_AMBARELLA_PHY=y
CONFIG_USB_GADGET=m
CONFIG_USB_GADGET_VBUS_DRAW=500
CONFIG_USB_AMBARELLA=m
CONFIG_USB_ETH=m
CONFIG_USB_MASS_STORAGE=m
CONFIG_USB_G_SERIAL=m
CONFIG_USB_G_MULTI=m
CONFIG_MMC=y
CONFIG_MMC_BLOCK_MINORS=32
# CONFIG_MMC_BLOCK_BOUNCE is not set
CONFIG_MMC_AMBARELLA=y
CONFIG_RTC_CLASS=y
# CONFIG_RTC_SYSTOHC is not set
CONFIG_RTC_DRV_AMBARELLA=y
# CONFIG_COMMON_CLK_XGENE is not set
# CONFIG_IOMMU_SUPPORT is not set
CONFIG_AMBARELLA_RPROC=y
CONFIG_RPMSG_ECHO=y
CONFIG_EXT2_FS=y
# CONFIG_DNOTIFY is not set
CONFIG_VFAT_FS=y
CONFIG_TMPFS=y
CONFIG_TMPFS_POSIX_ACL=y
CONFIG_HUGETLBFS=y
CONFIG_CONFIGFS_FS=y
CONFIG_NFS_FS=y
CONFIG_ROOT_NFS=y
CONFIG_NFSD=m
CONFIG_NFSD_V3=y
CONFIG_CIFS=y
CONFIG_CIFS_STATS=y
CONFIG_NLS_DEFAULT="utf8"
CONFIG_NLS_CODEPAGE_437=y
CONFIG_NLS_ISO8859_1=y
CONFIG_NLS_UTF8=y
CONFIG_PRINTK_TIME=y
CONFIG_DYNAMIC_DEBUG=y
CONFIG_DEBUG_INFO=y
CONFIG_DEBUG_FS=y
CONFIG_DEBUG_SECTION_MISMATCH=y
CONFIG_DEBUG_KERNEL=y
CONFIG_LOCKUP_DETECTOR=y
# CONFIG_SCHED_DEBUG is not set
# CONFIG_FTRACE is not set
CONFIG_KEYS=y
CONFIG_CRYPTO_CRC32C=y
CONFIG_CRYPTO_DEFLATE=y
CONFIG_CRYPTO_LZO=y
CONFIG_CRYPTO_ANSI_CPRNG=y
CONFIG_ARM64_CRYPTO=y
CONFIG_CRYPTO_SHA1_ARM64_CE=y
CONFIG_CRYPTO_SHA2_ARM64_CE=y
CONFIG_CRYPTO_GHASH_ARM64_CE=y
CONFIG_CRYPTO_AES_ARM64_CE_CCM=y
CONFIG_CRYPTO_AES_ARM64_CE_BLK=y
CONFIG_CRYPTO_AES_ARM64_NEON_BLK=y
CONFIG_CRC16=y
CONFIG_CRC_ITU_T=y
CONFIG_CRC7=y
```

## sources/linux-4.9.0/linux-4.9.0/drivers/ambalink/rpc/Kconfig
```kconfig
config AMBALINK_RPC
        bool "AmbaLink RPC support"
        depends on RPMSG
        depends on AMBARELLA_RPROC
        default y
        help
          AmbaLink Remote Procedure Call

config AMBALINK_RFS
        bool "AmbaLink RFS Support"
        depends on RPMSG
        default y
        help
          Enable RTOS to read/write ramfs through RPMSG

config AMBALINK_VFFS
        bool "AmbaLink FUSE VFFS"
        depends on RPMSG
        default n
        help
          A user space file system for RTOS accessing Linux, called FUSE VFFS.
```

## sources/linux-4.9.0/linux-4.9.0/drivers/ambalink/service/Kconfig
```kconfig
config AMBALINK_LINKCTRL
        bool "AmbaLink System Control"
        depends on RPMSG
        default y
        help
          A rpmsg server to handle the message between client and server for
          control purpose, such as suspend, resume.

config AMBALINK_SD
        bool "AmbaLink SD Card Control"
        depends on RPMSG
        default n
        help
          AmbaLink SD controller RPMSG host driver.

config AMBALINK_PPM
        tristate "AmbaLink PPM device"
	default n
	help 
	  create /dev/ppm to mmap physical memory 
```

## sources/linux-4.9.0/linux-4.9.0/drivers/parrot/Kconfig
```kconfig
menuconfig PARROT
	bool "Parrot drivers"
	default n

if PARROT

source "drivers/parrot/gpio/Kconfig"
source "drivers/parrot/i2c/Kconfig"
source "drivers/parrot/iio/Kconfig"
source "drivers/parrot/misc/Kconfig"
source "drivers/parrot/stepper/Kconfig"
source "drivers/parrot/video/Kconfig"
source "drivers/parrot/wifi/Kconfig"
source "drivers/parrot/smartbattery/Kconfig"

endif #PARROT
```

## sources/linux-4.9.0/linux-4.9.0/drivers/parrot/i2c/Kconfig
```kconfig
menu "I2C Parrot drivers"

config I2C_THREADX
	#THREADX-DEPENDS: CONFIG_PARROT_PSI2C=y
	tristate "ThreadX shared I2C bus support (PSI2C)"
	depends on ARCH_AMBARELLA
	select I2C
	help
	  This driver allows to use an I2C bus managed by ThreadX, thanks to
	  PS I2C rpmsg protocol.

endmenu
```

## sources/linux-4.9.0/linux-4.9.0/drivers/parrot/iio/Kconfig
```kconfig
#
# Industrial I/O subsystem configuration
#
menu "IIO Parrot drivers"
	depends on IIO

source "drivers/parrot/iio/bldc/Kconfig"
source "drivers/parrot/iio/amba_a9s_adc/Kconfig"

endmenu
```

## sources/linux-4.9.0/linux-4.9.0/drivers/parrot/iio/amba_a9s_adc/Kconfig
```kconfig
config IIO_AMBA_A9S_ADC
	tristate "Ambarella ADC driver"
	depends on IIO_KFIFO_BUF  && (IIO_AMBA_A9S_ADC_RPMSG || IIO_AMBA_A9S_ADC_LOCAL)
	help
		Enable Ambarella/Parrot ADC driver
choice
	prompt "Ambarella ADC backend"

config IIO_AMBA_A9S_ADC_RPMSG
	#THREADX-DEPENDS: CONFIG_PARROT_ADC_DISABLED is not set
	bool "ThreadX"
	help
		This backend delegates all the work to ThreadX core.

config IIO_AMBA_A9S_ADC_LOCAL
	#THREADX-DEPENDS: CONFIG_PARROT_ADC_DISABLED=y
	bool "Linux stand-alone"
	help
		This backend executes all ADC commands locally, without relying on ThreadX.
endchoice

config IIO_AMBA_A9S_ADC_ENABLE_FIFO_BURST_READ
	depends on IIO_AMBA_A9S_ADC_LOCAL
	bool "Enable FIFO burst-read"
  default n
	help
		Enable to read FIFO 32 entries at once, instead of reading entries one by one
```

## sources/linux-4.9.0/linux-4.9.0/drivers/parrot/iio/bldc/Kconfig
```kconfig
#
# BLDC drivers
#
menu "BLDC Motor"

source "drivers/parrot/iio/bldc/cypress/Kconfig"

endmenu
```

## sources/linux-4.9.0/linux-4.9.0/drivers/parrot/iio/bldc/cypress/Kconfig
```kconfig
#
# BLDC drivers
#

config IIO_PARROT_BLDC_CYPRESS
	tristate "Parrot BLDC Cypress driver"
	depends on I2C && SYSFS
	select IIO_PARROT_BLDC_CYPRESS_I2C if (I2C)
	select IIO_BUFFER
	select IIO_TRIGGERED_BUFFER
	help
	  Say yes here to build support for Cypress motor control
	  connected with I2C.

	  To compile this driver as a module, choose M here: the module will be
	  called mpsoc-i2c.

config IIO_PARROT_BLDC_CYPRESS_I2C
	tristate
	depends on IIO_PARROT_BLDC_CYPRESS
```

## sources/linux-4.9.0/linux-4.9.0/drivers/parrot/smartbattery/Kconfig
```kconfig
menu "Smartbattery Parrot drivers"

config PARROT_SMARTBATTERY
	tristate "Parrot Smartbattery driver"
	depends on I2C
	depends on SYSFS

config PARROT_SMARTBATTERY_KTHREAD_PRIO
	int "Smartbattery kthread priority"
	range 1 99
	default 1
	depends on PARROT_SMARTBATTERY

endmenu
```

## sources/linux-4.9.0/linux-4.9.0/drivers/parrot/video/Kconfig
```kconfig
menu "Video Parrot drivers"

config VIDEO_SPIT
	tristate "Spit"
	help
	  To manage video buffer exchange from ThreadX to Linux

endmenu
```

## sources/linux-4.9.0/linux-4.9.0/fs/ambavfs/Kconfig
```kconfig
config AMBALINK_VFS
	tristate "Ambarella AmbaLink Virutal File System"
	depends on ARCH_AMBARELLA_AMBALINK && RPMSG
	default y
	help
	  Enable Linux to read/write RTOS native FS
```

## sources/linux-4.9.0/linux-4.9.0/sound/soc/ambarella/Kconfig
```kconfig
config SND_AMBARELLA_SOC
	tristate "SoC Audio for the Ambarella chips"
	depends on ARCH_AMBARELLA && SND_SOC
	select SND_SOC_GENERIC_DMAENGINE_PCM
	select SND_AMBARELLA_SOC_I2S
	select SND_SOC_AMBARELLA_DUMMY
	help
	  Say Y or M if you want to add support for codecs attached to
	  the AMBARELLA I2S interface. You will also need
	  to select the audio interfaces to support below.

config SND_AMBARELLA_SOC_I2S
	tristate

menuconfig SND_AMBARELLA_CODEC
	tristate "Select Codec for Ambarella Platform"
	depends on SND_AMBARELLA_SOC
	help
	  Say Y or M to select specific Codec for Ambarella Platform.

if SND_AMBARELLA_CODEC

config SND_SOC_AK4642_AMB
	tristate "AK4642 for Ambarella"
	help
		Support AK4642 Audio Codec Driver for Ambarella Platform.

config SND_SOC_AK4951_AMB
	tristate "AK4951 for Ambarella"
	help
		Support AK4951 Audio Codec for Ambarella Platform.

config SND_SOC_AK4954_AMB
	tristate "AK4954 for Ambarella"
	help
		Support AK4954 Audio Codec for Ambarella Platform

config SND_SOC_AK7719_DSP
	tristate "AK7719_DSP for Ambarella"
	depends on SND_AMBARELLA_SOC && (SND_SOC_AK4954_AMB || SND_SOC_AK4951_AMB)
	help
	  Say Y if you want to add AK7719 DSP support for
	  SoC audio on Ambarella Board.
	  and the AK7719_DSP should be modprobed before AK4954/AK4951.

config SND_SOC_AK7755
	tristate "AK7755 for Ambarella"
	help
		Support AK7755 for Ambarella Platform.

config SND_SOC_TLV320ADC3xxx
	tristate "TLV320ADC3xxx for Ambarella"
	help
		Support TLV320ADC3xxx for Ambarella Platform.

config SND_SOC_ES8388
	tristate "ES8388 for Ambarella"
	help
		Support ES8388 Audio Codec.

config SND_SOC_WM8974_AMB
	tristate "WM8974 for Ambarella"
	help
		Support WM8974 Audio Codec for Ambarella Platform.

config SND_SOC_WM8940_AMB
	tristate "WM8940 for Ambarella"
	help
		Support WM8940 Audio Codec for Ambarella Platform

config SND_AMBARELLA_SOC_DMIC
	tristate "Ambarella DMIC"
	depends on SND_AMBARELLA_SOC
	depends on SND_AMBARELLA_SOC_I2S
	help
		Say Y or M to select the DMIC Interface of Ambarella

endif
```
